SYStem.Option EnReset OFF
SYStem.JTAGCLOCK 4MHz
SYStem.CPU CORTEXA53
SYStem.CONFIG CoreNumber 4.
CORE.ASSIGN 1. 2. 3. 4.
SYStem.CONFIG DEBUGACCESSPORT 0.
SYStem.CONFIG.COREDEBUG.Base 0x80010000 0x80012000 0x80014000 0x80016000
SYStem.CONFIG.CTI.BASE 0x80018000 0x80019000 0x8001A000 0x8001B000
SYStem.CONFIG.BMC.Base 0x80011000 0x80013000 0x80015000 0x80017000

SYStem.Mode Attach

IF state.RUN()
Break

; open some windows
WinCLEAR
WinPOS 0% 0% 50% 50%
List.auto
WinPOS 0% 50% 50% 50%
Frame /Locals /Caller
WinPOS 50% 50% 50% 50%
PER.view
WinPOS 50% 0% 50% 50%
Register.view /SpotLight

ENDDO